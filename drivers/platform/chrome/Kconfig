## samples/Kconfig
```kconfig
# SPDX-License-Identifier: GPL-2.0
#
# Placeholder Kconfig for trimmed tree.
#

menu "samples (stub)"

endmenu
```

## sound/Kconfig
```kconfig
# SPDX-License-Identifier: GPL-2.0
#
# Placeholder Kconfig for trimmed tree.
#

menu "sound (stub)"

endmenu
```
