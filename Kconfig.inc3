## arch/mips/crypto/Kconfig
```kconfig
# SPDX-License-Identifier: GPL-2.0
#
# Placeholder arch crypto Kconfig for trimmed tree.

menu "Arch crypto (stub)"

endmenu
```

## drivers/auxdisplay/Kconfig
```kconfig
# SPDX-License-Identifier: GPL-2.0
#
# Placeholder auxdisplay Kconfig for trimmed tree.
#

menu "Auxiliary display drivers (stub)"

endmenu
```

## drivers/bluetooth/Kconfig
```kconfig
# SPDX-License-Identifier: GPL-2.0
#
# Placeholder Bluetooth Kconfig for trimmed tree.
#

menu "Bluetooth drivers (stub)"

endmenu
```

## drivers/firewire/Kconfig
```kconfig
# SPDX-License-Identifier: GPL-2.0
#
# Placeholder FireWire Kconfig for trimmed tree.
#

menu "FireWire drivers (stub)"

endmenu
```

## drivers/fpga/Kconfig
```kconfig
# SPDX-License-Identifier: GPL-2.0
#
# Placeholder Kconfig for trimmed tree.
#

menu "fpga (stub)"

endmenu
```

## drivers/fsi/Kconfig
```kconfig
# SPDX-License-Identifier: GPL-2.0
#
# Placeholder Kconfig for trimmed tree.
#

menu "fsi (stub)"

endmenu
```

## drivers/gnss/Kconfig
```kconfig
# SPDX-License-Identifier: GPL-2.0
#
# Placeholder GNSS Kconfig for trimmed tree.
#

menu "GNSS drivers (stub)"

endmenu
```

## drivers/gpu/host1x/Kconfig
```kconfig
# SPDX-License-Identifier: GPL-2.0
#
# Placeholder host1x Kconfig for trimmed tree.
#

menu "Host1x drivers (stub)"

endmenu
```

## drivers/gpu/ipu-v3/Kconfig
```kconfig
# SPDX-License-Identifier: GPL-2.0
#
# Placeholder ipu-v3 Kconfig for trimmed tree.
#

menu "IPU v3 drivers (stub)"

endmenu
```

## drivers/gpu/trace/Kconfig
```kconfig
# SPDX-License-Identifier: GPL-2.0
#
# Placeholder Kconfig for trimmed tree.
#

menu "trace (stub)"

endmenu
```

## drivers/gpu/vga/Kconfig
```kconfig
# SPDX-License-Identifier: GPL-2.0
#
# Placeholder VGA Kconfig for trimmed tree.
#

menu "VGA drivers (stub)"

endmenu
```

## drivers/greybus/Kconfig
```kconfig
# SPDX-License-Identifier: GPL-2.0
#
# Placeholder Kconfig for trimmed tree.
#

menu "greybus (stub)"

endmenu
```

## drivers/hid/Kconfig
```kconfig
# SPDX-License-Identifier: GPL-2.0
#
# Placeholder Kconfig for trimmed tree.
#

menu "hid (stub)"

endmenu
```

## drivers/infiniband/Kconfig
```kconfig
# SPDX-License-Identifier: GPL-2.0
#
# Placeholder Kconfig for trimmed tree.
#

menu "infiniband (stub)"

endmenu
```

## drivers/input/gameport/Kconfig
```kconfig
# SPDX-License-Identifier: GPL-2.0
#
# Placeholder gameport Kconfig for trimmed tree.
#

menu "Input gameport drivers (stub)"

endmenu
```

## drivers/input/joystick/Kconfig
```kconfig
# SPDX-License-Identifier: GPL-2.0
#
# Placeholder joystick Kconfig for trimmed tree.
#

menu "Input joystick drivers (stub)"

endmenu
```

## drivers/input/tablet/Kconfig
```kconfig
# SPDX-License-Identifier: GPL-2.0
#
# Placeholder tablet Kconfig for trimmed tree.
#

menu "Input tablet drivers (stub)"

endmenu
```

## drivers/input/touchscreen/Kconfig
```kconfig
# SPDX-License-Identifier: GPL-2.0
#
# Placeholder touchscreen Kconfig for trimmed tree.
#

menu "Input touchscreen drivers (stub)"

endmenu
```

## drivers/isdn/Kconfig
```kconfig
# SPDX-License-Identifier: GPL-2.0
#
# Placeholder ISDN Kconfig for trimmed tree.
#

menu "ISDN drivers (stub)"

endmenu
```

## drivers/media/Kconfig
```kconfig
# SPDX-License-Identifier: GPL-2.0
#
# Placeholder media Kconfig for trimmed tree.
#

menu "Media drivers (stub)"

endmenu
```

## drivers/mtd/Kconfig
```kconfig
# SPDX-License-Identifier: GPL-2.0
#
# Placeholder MTD Kconfig for trimmed tree.
#

menu "MTD drivers (stub)"

endmenu
```

## drivers/nfc/Kconfig
```kconfig
# SPDX-License-Identifier: GPL-2.0
#
# Placeholder NFC Kconfig for trimmed tree.
#

menu "NFC drivers (stub)"

endmenu
```

## drivers/parport/Kconfig
```kconfig
# SPDX-License-Identifier: GPL-2.0
#
# Placeholder Parport Kconfig for trimmed tree.
#

menu "Parport drivers (stub)"

endmenu
```

## drivers/pcmcia/Kconfig
```kconfig
# SPDX-License-Identifier: GPL-2.0
#
# Placeholder PCMCIA Kconfig for trimmed tree.
#

menu "PCMCIA drivers (stub)"

endmenu
```
